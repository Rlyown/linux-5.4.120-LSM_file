## security/file_sec_opt/Kconfig
```kconfig
#Kconfig

config FILE_SECURITY_OPERATION
	bool "file_security_operation_support"
	depends on SECURITY
	default y
	help 
		introduction of demo of file security opeartion modules
```

## security/integrity/cpcr/Kconfig
```kconfig
# Core Platform Configuration Register
#
config CPCR
    bool "Core Platform Configuration Register"
    default n
    select IMA
    help
      Enable cPCR
```

## security/sec_file/Kconfig
```kconfig
config SECURITY_FILE
	bool "sec_file - LSM"
	depends on SECURITY
	select SECURITYFS
	default y
	help 
		This is the security_file_operation modules.
```

## security/uob/Kconfig
```kconfig
config SECURITY_UOB
    bool "UoB - LSM"
    depends on SECURITY
    depends on NET
    depends on INET
    select SECURITY_NETWORK
    select SECURITYFS
    default y
    help
        This our lab LSM module
```
